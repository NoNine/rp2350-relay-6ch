## firmware/boards/waveshare/waveshare_rp2350_relay_6ch/Kconfig.defconfig
```kconfig
# SPDX-License-Identifier: Apache-2.0

if BOARD_WAVESHARE_RP2350_RELAY_6CH

config USB_SELF_POWERED
	default n

if WIFI_AIROC

choice AIROC_PART
	default CYW43439
endchoice

config WHD_DISABLE_SDIO_PULLUP_DURING_SPI_SLEEP
	default y

endif # WIFI_AIROC

endif # BOARD_WAVESHARE_RP2350_RELAY_6CH
```

## firmware/boards/waveshare/waveshare_rp2350_relay_6ch/Kconfig.waveshare_rp2350_relay_6ch
```kconfig
# SPDX-License-Identifier: Apache-2.0

config BOARD_WAVESHARE_RP2350_RELAY_6CH
	select SOC_RP2350B_M33 if BOARD_WAVESHARE_RP2350_RELAY_6CH_RP2350B_M33 || BOARD_WAVESHARE_RP2350_RELAY_6CH_RP2350B_M33_W
```

## firmware/boards/waveshare/waveshare_rp2350_relay_6ch/board.yml
```yaml
board:
  name: waveshare_rp2350_relay_6ch
  full_name: Waveshare RP2350-Relay-6CH
  vendor: waveshare
  socs:
    - name: rp2350b
      variants:
        - name: w
          cpucluster: m33
```

## firmware/tests/health/testcase.yaml
```yaml
tests:
  rp2350_relay_6ch.health:
    platform_allow:
      - native_sim
    tags:
      - health
    harness: ztest
```

## firmware/tests/indicator/testcase.yaml
```yaml
tests:
  rp2350_relay_6ch.indicator:
    platform_allow:
      - native_sim
    tags:
      - indicator
      - led
      - pwm
    harness: ztest
  rp2350_relay_6ch.indicator.buzzer_feedback:
    platform_allow:
      - native_sim
    extra_configs:
      - CONFIG_RP2350_RELAY_6CH_BUZZER_FEEDBACK=y
    tags:
      - indicator
      - led
      - pwm
    harness: ztest
  rp2350_relay_6ch.indicator.accepted_buzzer_feedback:
    platform_allow:
      - native_sim
    extra_configs:
      - CONFIG_RP2350_RELAY_6CH_BUZZER_FEEDBACK=y
      - CONFIG_RP2350_RELAY_6CH_BUZZER_ACCEPTED_FEEDBACK=y
    tags:
      - indicator
      - led
      - pwm
    harness: ztest
  rp2350_relay_6ch.indicator.display_rotated_180:
    platform_allow:
      - native_sim
    extra_configs:
      - CONFIG_RP2350_RELAY_6CH_DISPLAY_ROTATED_180=y
    tags:
      - indicator
      - led
      - pwm
    harness: ztest
  rp2350_relay_6ch.indicator.display_reversed_relay_cells:
    platform_allow:
      - native_sim
    extra_configs:
      - CONFIG_RP2350_RELAY_6CH_DISPLAY_REVERSED_RELAY_CELLS=y
    tags:
      - indicator
      - led
      - pwm
    harness: ztest
```

## firmware/tests/relay_mgmt/testcase.yaml
```yaml
tests:
  rp2350_relay_6ch.relay_mgmt:
    platform_allow:
      - native_sim
    tags:
      - gpio
      - mcumgr
      - relay
    harness: ztest
  rp2350_relay_6ch.relay_mgmt.comm_loss_energized_only:
    platform_allow:
      - native_sim
    tags:
      - gpio
      - mcumgr
      - relay
    harness: ztest
    extra_configs:
      - CONFIG_RP2350_RELAY_6CH_COMM_LOSS_ENERGIZED_ONLY=y
      - CONFIG_RP2350_RELAY_6CH_COMM_LOSS_TIMEOUT_MS=50
  rp2350_relay_6ch.relay_mgmt.comm_loss_no_timeout:
    platform_allow:
      - native_sim
    tags:
      - gpio
      - mcumgr
      - relay
    harness: ztest
    extra_configs:
      - CONFIG_RP2350_RELAY_6CH_COMM_LOSS_NO_TIMEOUT=y
  rp2350_relay_6ch.relay_mgmt.comm_loss_always_on_owner:
    platform_allow:
      - native_sim
    tags:
      - gpio
      - mcumgr
      - relay
    harness: ztest
    extra_configs:
      - CONFIG_RP2350_RELAY_6CH_COMM_LOSS_ALWAYS_ON_OWNER=y
      - CONFIG_RP2350_RELAY_6CH_COMM_LOSS_TIMEOUT_MS=50
  rp2350_relay_6ch.relay_mgmt.comm_loss_always_on_owner_reboot:
    platform_allow:
      - native_sim
    tags:
      - gpio
      - mcumgr
      - relay
    harness: ztest
    extra_configs:
      - CONFIG_REBOOT=y
      - CONFIG_RP2350_RELAY_6CH_COMM_LOSS_ALWAYS_ON_OWNER=y
      - CONFIG_RP2350_RELAY_6CH_COMM_LOSS_ALWAYS_ON_OWNER_REBOOT_ON_TIMEOUT=y
      - CONFIG_RP2350_RELAY_6CH_COMM_LOSS_TIMEOUT_MS=50
      - CONFIG_RP2350_RELAY_6CH_COMM_LOSS_REBOOT_DELAY_MS=100
```

## firmware/tests/watchdog/testcase.yaml
```yaml
common:
  tags:
    - watchdog
    - firmware
tests:
  rp2350_relay_6ch.watchdog:
    platform_allow:
      - native_sim
```
